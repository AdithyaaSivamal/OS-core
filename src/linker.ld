ENTRY(_start)
SECTIONS
{
    /* Set the virtual address where the kernel will be loaded */
    . = 0x1000;

    .text : {
        *(.multiboot)
        *(.text*)
    }

    .rodata : {
        *(.rodata*)
    }

    .data : {
        *(.data*)
    }

    .bss : {
        __bss_start = .;
        *(.bss*)
        *(COMMON)
        __bss_end = .;
    }
}

